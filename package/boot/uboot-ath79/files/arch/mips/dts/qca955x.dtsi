// SPDX-License-Identifier: GPL-2.0+
/*
 * Copyright (C) 2015-2016 Wills Wang <wills.wang@live.com>
 */


#include <dt-bindings/interrupt-controller/irq.h>
#include <dt-bindings/clock/ath79-clk.h>
#include "skeleton.dtsi"

/ {
	compatible = "qca,qca955x";

	#address-cells = <1>;
	#size-cells = <1>;

	cpus {
		#address-cells = <1>;
		#size-cells = <0>;

		cpu@0 {
			device_type = "cpu";
			compatible = "mips,mips74Kc";
			clocks = <&pll ATH79_CLK_CPU>;
			reg = <0>;
		};
	};

	clocks {
		#address-cells = <1>;
		#size-cells = <1>;
		ranges;

		xtal: xtal {
			#clock-cells = <0>;
			compatible = "fixed-clock";
			clock-output-names = "xtal";
			clock-frequency = <40000000>;
		};
	};

	

	ahb {
		compatible = "simple-bus";
		ranges;

		#address-cells = <1>;
		#size-cells = <1>;

		apb {
			compatible = "simple-bus";
			ranges;

			#address-cells = <1>;
			#size-cells = <1>;

			uart0: uart@18020000 {
				compatible = "ns16550";
				reg = <0x18020000 0x20>;
				reg-shift = <2>;
				clocks = <&pll ATH79_CLK_REF>;
				interrupts = <3>;

				status = "disabled";
			};

			pinctrl: pinctrl@1804002c {
		u-boot,dm-pre-reloc;
		compatible = "qca,qca955x-pinctrl", "pinctrl-single";
		ranges;
		#address-cells = <1>;
		#size-cells = <1>;
		reg = <0x1804002c 0x44>;
		pinctrl-single,bit-per-mux;
		pinctrl-single,register-width = <32>;
		pinctrl-single,function-mask = <0x1>;
		#pinctrl-cells = <2>;
		jtag_disable_pins: pinmux_jtag_disable_pins {
					pinctrl-single,bits = <0x40 0x2  0x2>;
				};
		};

		gmac: gmac@18070000 {
			compatible = "qca,qca9550-gmac";
			reg = <0x18070000 0x58>;
		};

		spi0: spi@1f000000 {
			compatible = "qca,ar934x-spi";
			reg = <0x1f000000 0x1c>;
			interrupts = <129 IRQ_TYPE_LEVEL_HIGH>;
			clocks = <&pll ATH79_CLK_AHB>;

			status = "disabled";

			#address-cells = <1>;
			#size-cells = <0>;
		};
	};
};
&mdio0 {
	compatible = "qca,ar9340-mdio";
};

&eth0 {
	compatible = "qca,qca9550-eth", "syscon";

	pll-reg = <0 0x28 0>;
	pll-handle = <&pll>;

	pll-data = <0x16000000 0x00000101 0x00001616>;
	phy-mode = "rgmii";

	resets = <&rst 9>, <&rst 22>;
	reset-names = "mac", "mdio";
};

&mdio1 {
	compatible = "qca,ar9340-mdio";
};

&eth1 {
	compatible = "qca,qca9550-eth", "syscon";

	pll-reg = <0 0x48 0>;
	pll-handle = <&pll>;

	pll-data = <0x16000000 0x00000101 0x00001616>;
	phy-mode = "sgmii";

	resets = <&rst 13>, <&rst 23>;
	reset-names = "mac", "mdio";
};