## package/boot/uboot-ap135/files/configs/nbg6616_defconfig
```kconfig
CONFIG_MIPS=y
CONFIG_TARGET_QCA955X=y
CONFIG_SYS_CONFIG_NAME="nbg6616"
CONFIG_SYS_PROMPT="NBG6616# "
# CONFIG_CMD_BDI is not set
# CONFIG_CMD_ELF is not set
CONFIG_CMD_RUN=y
CONFIG_CMD_SAVEENV=y
CONFIG_CMD_PING=y
# CONFIG_CMD_LOADB is not set
# CONFIG_CMD_LOADS is not set
CONFIG_CMD_FLASH=y
# CONFIG_CMD_FPGA is not set
# CONFIG_CMD_SETEXPR is not set
CONFIG_USE_PRIVATE_LIBGCC=y
CONFIG_SYS_MALLOC_F_LEN=0x200
CONFIG_SYS_MALLOC_F=y
CONFIG_OF_LIBFDT=y
# CONFIG_OF_LIBFDT_OVERLAY
# CONFIG_OF_CONTROL
# CONFIG_DEFAULT_DEVICE_TREE="ap135"
# CONFIG_DEFAULT_FDT_FILE="ap135.dtb"
CONFIG_FIT=y
CONFIG_FIT_VERBOSE=y
CONFIG_SYS_TEXT_BASE=0x9f000000
CONFIG_NR_DRAM_BANKS=1
CONFIG_LAST_STAGE_INIT=y
```

## package/boot/uboot-ath79/files/board/qca/ap135/Kconfig
```kconfig
if TARGET_AP135

config SYS_VENDOR
	default "qca"

config SYS_BOARD
	default "ap135"

config SYS_CONFIG_NAME
	default "ap135"

endif
```

## package/boot/uboot-ath79/files/configs/ap135_defconfig
```kconfig
CONFIG_MIPS=y
CONFIG_MIPS_CACHE_INDEX_BASE=0x800000
CONFIG_MIPS_RELOCATION_TABLE_SIZE=0x8000
CONFIG_NR_DRAM_BANKS=1
CONFIG_DM=y
CONFIG_DM_SERIAL=y
CONFIG_DM_SPI=y
CONFIG_ATH79_SPI=y
CONFIG_DM_SPI_FLASH=y
CONFIG_ARCH_ATH79=y
CONFIG_TARGET_AP135=y
CONFIG_DEFAULT_DEVICE_TREE="ap135"
CONFIG_USE_ENV_SPI_MAX_HZ=y
CONFIG_ENV_SPI_MODE=3
CONFIG_SYS_PROMPT="ap135 # "
CONFIG_CMD_DM=y
# CONFIG_EXPERT is not set
# CONFIG_CMD_BDI is not set
# CONFIG_CMD_CONSOLE is not set
# CONFIG_CMD_ELF is not set
# CONFIG_CMD_IMLS is not set
# CONFIG_CMD_XIMG is not set
# CONFIG_CMD_EXPORTENV is not set
# CONFIG_CMD_IMPORTENV is not set
# CONFIG_CMD_EDITENV is not set
# CONFIG_CMD_CRC32 is not set
# CONFIG_CMD_FLASH is not set
CONFIG_FS_JFFS2=y
CONFIG_MTD_PARTITIONS=y
CONFIG_CMD_SF=y
CONFIG_CMD_SPI=y
# CONFIG_CMD_FPGA is not set
# CONFIG_CMD_NET is not set
# CONFIG_CMD_NFS
# CONFIG_SYS_LONGHELP is not set
CONFIG_PINCTRL=y
CONFIG_PINCTRL_FULL=y
CONFIG_PINCTRL_GENERIC=y
CONFIG_PINMUX=y
CONFIG_PINCTRL_SINGLE=y
CONFIG_DEBUG_UART=y
CONFIG_DEBUG_UART_BASE=0x18020000
CONFIG_DEBUG_UART_CLOCK=25000000
CONFIG_DEBUG_UART_SHIFT=2
CONFIG_DEBUG_UART_BOARD_INIT=y
CONFIG_SYS_NS16550=y
CONFIG_USE_PRIVATE_LIBGCC=y
CONFIG_OF_LIBFDT=y
CONFIG_OF_LIBFDT_OVERLAY=y
CONFIG_OF_CONTROL=y
CONFIG_OF_BOARD=y
CONFIG_NET=y
CONFIG_DM_ETH=y
CONFIG_NETDEVICES=y
CONFIG_PHY_ATHEROS=y
CONFIG_AG7XXX=y
CONFIG_RGMII=y
CONFIG_MII=y
CONFIG_PCI=y
CONFIG_DM_PCI=y
CONFIG_FIT=y
CONFIG_FIT_SIGNATURE=y
CONFIG_FIT_SIGNATURE_MAX_SIZE=0x10000000
CONFIG_SYS_TEXT_BASE=0x9f000000
```

## package/boot/uboot-zyxel/Config.in
```kconfig
menu "Kernel Images"
depends on PACKAGE_uboot-zyxel
	config EMBEDDED_KERNEL_IN_ROOTFS
		bool "To embedded the kernel image in rootfs image"
		default n
		help
		  Kernel image will be embedded into rootfs image when you 
		  enable this option.

	config PAD_KERNEL_IMG_TO_ALIGN_BYTE
		int "Pad kernel image to align bytes"
		default 2048
		depends on !EMBEDDED_KERNEL_IN_ROOTFS

	choice
		prompt "Kernel image default compression mode"
		default KERNEL_COMPRESS_MODE_LZMA
		depends on !arm
		help
		  You can set here the default compression mode of kernel image
		  from the available compression modes. Don't touch if unsure.

	config KERNEL_COMPRESS_MODE_NONE
		bool "no compression"
		help
		  Uses no compression.

	config KERNEL_COMPRESS_MODE_LZMA
		bool "LZMA"
		help
		  Uses LAMZ compression.

	config KERNEL_COMPRESS_MODE_GZIP
		bool "GZIP"
		help
		  Uses GZIP compression.
	endchoice
endmenu

menu "zloader Configuration"
depends on PACKAGE_uboot-zyxel

config ZYXEL_ZLOADER
	bool "ZyXEL zloader"
	default y
	help
		Keep zLoader, don't replace it with U-Boot
config UBOOT_ZYXEL_SUPPORT_ZLOADER
	bool "Support for ZyXEL zloader"
	default y
	depends on ZYXEL_ZLOADER
	help
		add zloader support to u-boot



choice
	prompt "Zloader default compression mode"
		default ZLOADER_COMPRESS_MODE_LZMA
		depends on ZYXEL_ZLOADER
		help
		  You can set here the default compression mode for zLoader
		  from the available compression modes. Don't touch if unsure.
	
	config ZLOADER_COMPRESS_MODE_NONE
		bool "no compression"
		help
		  Uses no compression.

	config ZLOADER_COMPRESS_MODE_LZMA
		bool "LZMA"
		help
		  Uses LZMA compression.

	config ZLOADER_COMPRESS_MODE_GZIP
		bool "GZIP"
		help
		  Uses GZIP compression.
	endchoice


endmenu
menu "uboot-zyxel Configuration"
	depends on PACKAGE_uboot-zyxel

config UBOOT_ZYXEL_RAMBOOT
	bool "Enable RAM boot image"
	help
	  To build u-boot image for booting from RAM not ROM.
	  While executing the image in the RAM the functionality of the uboot image can be tested first without touching 
	  the original flash.
	  Note: Be carefull, by saving the environment the flash will be modified.

config UBOOT_ZYXEL_TARGET
	string "u-boot config"
	default "rt6856evm" if TARGET_rt6856_rt6856evm
	default "amitsample" if TARGET_rt6856_amitsample
	default "nbg5615" if TARGET_rt6856_nbg5615
	default "pla4231" if TARGET_ar934x_pla4231
	default "nbg6616" if TARGET_ath79_generic_DEVICE_zyxel_nbg6616
	default "nbg6716" if TARGET_ath79_nand_DEVICE_zyxel_nbg6716

config UBOOT_ZYXEL_SUPPORT_ROMD
	bool "Support ROM_D partition"
	default n
	help
		Support ROM_D partition


endmenu
```
